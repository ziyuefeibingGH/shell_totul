/*************************
 * Customized Battery Setting dtsi file
*************************/
&bat_comm {
	/* cust_charging.h */
	/* stop charging while in talking mode */
	stop_charging_in_takling = <1>;
	talking_recharge_voltage = <3800>;
	talking_sync_time = <60>;

	/* Battery Temperature Protection */
	mtk_temperature_recharge_support = <1>;
	max_charge_temperature = <65>;
	max_charge_temperature_minus_x_degree = <47>;
	min_charge_temperature = <0>;
	min_charge_temperature_plus_x_degree = <6>;
	err_charge_temperature = <0xff>;

	/* Linear Charging Threshold */
	v_pre2cc_thres = <3400>;	/* unit: mV */
	v_cc2topoff_thres = <4050>;
	recharging_voltage = <4200>;
	charging_full_current = <100>;	/* unit: mA */

	/* Charging Current Setting */
	config_usb_if = <0>;
	usb_charger_current_suspend = <0>;	/* Unit: 0.01 mA */
	usb_charger_current_unconfigured = <7000>;	/* Unit: 0.01 mA */
	usb_charger_current_configured = <50000>;	/* Unit: 0.01 mA */
	usb_charger_current = <50000>;	/* Unit: 0.01 mA */
	ac_charger_current = <180000>;	/* Unit: 0.01 mA */
	ac_charger_input_current = <200000>;
	non_std_ac_charger_current = <180000>;	/* Unit: 0.01 mA */
	charging_host_charger_current = <65000>;	/* Unit: 0.01 mA */
	apple_0_5a_charger_current = <50000>;	/* Unit: 0.01 mA */
	apple_1_0a_charger_current = <65000>;	/* Unit: 0.01 mA */
	apple_2_1a_charger_current = <80000>;	/* Unit: 0.01 mA */

	/* charger error check */
	bat_low_temp_protect_enable = <0>;
	v_charger_enable = <0>;	/* 1:on , 0:off */
	v_charger_max = <6500>;	/* unit: mV */
	v_charger_min = <4400>;

	/*  Tracking TIME */
	onehundred_percent_tracking_time = <10>;	/* Unit: second */
	npercent_tracking_time = <20>;	/* Unit: second */
	sync_to_real_tracking_time = <60>;	/* Unit: second */
	v_0percent_tracking = <3450>;	/* Unit: mV */

	/* High battery support */
	high_battery_voltage_support = <1>;
};

&bat_meter {
	/* cust_battery_meter.h */
	/* ADC resistor  */
	r_bat_sense = <4>;
	r_i_sense = <4>;
	r_charger_1 = <330>;
	r_charger_2 = <39>;
	temperature_t0 = <110>;
	temperature_t1 = <0>;
	temperature_t2 = <25>;
	temperature_t3 = <50>;
	temperature_t = <255>;	/* this should be fixed, never change the value */
	fg_meter_resistance = <0>;

	/* Qmax for 0mA */
	q_max_pos_50 = <4868>;//6368
	q_max_pos_25 = <5024>;//6524
	q_max_pos_0 = <4924>;//6424
	q_max_neg_10 = <4751>;//6251
	/* Qmax for 600mA, said high current */
	q_max_pos_50_h_current = <4840>;//6340
	q_max_pos_25_h_current = <4945>;//6445
	q_max_pos_0_h_current = <4816>;//6316
	q_max_neg_10_h_current = <4354>;//5854
	/* Discharge percentage, 1: D5, 0: D2 */
	oam_d5 = <0>;

	change_tracking_point = <1>;
	/* SW OCV tracking setting */
	cust_tracking_point = <14>;
	cust_r_sense = <200>;
	cust_hw_cc = <0>;
	aging_tuning_value = <100>;
	cust_r_fg_offset = <0>;
	ocv_board_compesate = <0>;
	r_fg_board_base = <1000>;
	r_fg_board_slope = <1000>;
	car_tune_value = <89>;

	/* HW Fuel gague  */
	current_detect_r_fg = <10>;	/* Unit: mA */
	minerroroffset = <1000>;
	fg_vbat_average_size = <18>;
	r_fg_value = <0>;	/* Unit: mOhm */

	cust_poweron_delta_capacity_tolrance = <80>;
	cust_poweron_low_capacity_tolrance = <2>;
	cust_poweron_max_vbat_tolrance = <70>;
	cust_poweron_delta_vbat_tolrance = <60>;
	cust_poweron_delta_hw_sw_ocv_capacity_tolrance = <10>;

	/* Fixed battery temperature */
	fixed_tbat_25 = <0>;
	/* Dynamic change wake up period of battery thread when suspend */
	vbat_normal_wakeup = <3600>;	/* Unit: mV */
	vbat_low_power_wakeup = <3500>;	/* Unit: mV */
	normal_wakeup_period = <5400>;	/* Unit: second */
	low_power_wakeup_period = <300>;	/* Unit: second */
	close_poweroff_wakeup_period = <30>;	/* Unit: second */

	rbat_pull_up_r = <16900>;
	rbat_pull_up_volt = <1800>;

	batt_temperature_table_num = <17>;
	batt_temperature_table = <
			    (-20) 75022
			    (-15) 57926
			    (-10) 45168
			    (-5) 35548
			    0 28224
			    5 22595
			    10 18231
			    15 14820
			    20 12133
			    25 10000 
			    30 8295 
			    35 6922 
			    40 5810 
			    45 4903 
			    50 4160 
			    55 3547 
			    60 3039>;

	battery_profile_t0_num = <102>;
	battery_profile_t0 = <0 4330
						1 4315
						2 4302
						3 4279
						4 4269
						5 4260
						6 4250
						7 4242
						8 4231
						9 4213
						10 4205
						11 4196
						12 4187
						13 4179
						14 4162
						15 4153
						16 4144
						17 4135
						18 4126
						19 4117
						20 4101
						21 4094
						22 4088
						23 4083
						24 4077
						25 4070
						26 4046
						27 4030
						28 4013
						29 3997
						30 3983
						31 3972
						32 3952
						33 3944
						34 3937
						35 3931
						36 3925
						37 3920
						38 3909
						39 3904
						40 3900
						41 3894
						42 3889
						43 3879
						44 3873
						45 3868
						46 3864
						47 3859
						48 3855
						49 3846
						50 3841
						51 3838
						52 3834
						53 3830
						54 3826
						55 3820
						56 3816
						57 3813
						58 3810
						59 3806
						60 3804
						61 3798
						62 3796
						63 3793
						64 3791
						65 3789
						66 3787
						67 3783
						68 3782
						69 3780
						70 3779
						71 3777
						72 3773
						73 3771
						74 3769
						75 3767
						76 3764
						77 3762
						78 3756
						79 3752
						80 3748
						81 3744
						82 3740
						83 3736
						84 3726
						85 3721
						86 3717
						87 3712
						88 3710
						89 3707
						90 3702
						91 3699
						92 3695
						93 3689
						94 3679
						95 3662
						96 3610
						97 3576
						98 3535
						99 3483
						100 3418
						100 3400>;

	battery_profile_t1_num = <102>;
	battery_profile_t1 = <0 4346
						1 4333
						2 4310
						3 4300
						4 4290
						5 4281
						6 4271
						7 4254
						8 4245
						9 4236
						10 4227
						11 4218
						12 4201
						13 4192
						14 4184
						15 4176
						16 4168
						17 4150
						18 4142
						19 4133
						20 4125
						21 4116
						22 4100
						23 4094
						24 4089
						25 4085
						26 4080
						27 4063
						28 4049
						29 4032
						30 4016
						31 4002
						32 3981
						33 3972
						34 3965
						35 3958
						36 3951
						37 3939
						38 3933
						39 3927
						40 3920
						41 3913
						42 3900
						43 3894
						44 3888
						45 3882
						46 3876
						47 3867
						48 3862
						49 3857
						50 3853
						51 3849
						52 3841
						53 3837
						54 3834
						55 3830
						56 3826
						57 3820
						58 3817
						59 3814
						60 3811
						61 3808
						62 3803
						63 3800
						64 3798
						65 3795
						66 3793
						67 3789
						68 3787
						69 3785
						70 3783
						71 3781
						72 3778
						73 3776
						74 3774
						75 3772
						76 3769
						77 3764
						78 3761
						79 3758
						80 3755
						81 3751
						82 3742
						83 3738
						84 3734
						85 3730
						86 3724
						87 3712
						88 3708
						89 3706
						90 3704
						91 3702
						92 3699
						93 3696
						94 3690
						95 3676
						96 3654
						97 3588
						98 3544
						99 3489
						100 3413
						100 3400>;

	battery_profile_t2_num = <102>;
	battery_profile_t2 = <0 4340
						1 4336
						2 4319
						3 4310
						4 4300
						5 4290
						6 4281
						7 4262
						8 4253
						9 4244
						10 4235
						11 4218
						12 4208
						13 4200
						14 4191
						15 4182
						16 4164
						17 4156
						18 4147
						19 4139
						20 4122
						21 4113
						22 4105
						23 4096
						24 4088
						25 4073
						26 4069
						27 4066
						28 4059
						29 4038
						30 4024
						31 4010
						32 4000
						33 3991
						34 3979
						35 3975
						36 3971
						37 3967
						38 3956
						39 3948
						40 3941
						41 3932
						42 3923
						43 3904
						44 3895
						45 3888
						46 3881
						47 3870
						48 3865
						49 3860
						50 3855
						51 3846
						52 3842
						53 3839
						54 3835
						55 3831
						56 3824
						57 3821
						58 3818
						59 3814
						60 3808
						61 3806
						62 3803
						63 3800
						64 3798
						65 3792
						66 3790
						67 3788
						68 3786
						69 3781
						70 3778
						71 3775
						72 3772
						73 3768
						74 3761
						75 3758
						76 3755
						77 3752
						78 3745
						79 3743
						80 3740
						81 3737
						82 3732
						83 3724
						84 3718
						85 3713
						86 3709
						87 3699
						88 3693
						89 3690
						90 3689
						91 3688
						92 3686
						93 3685
						94 3682
						95 3679
						96 3643
						97 3608
						98 3565
						99 3511
						100 3439
						100 3400>;

	battery_profile_t3_num = <102>;
	battery_profile_t3 = <0 4329
						1 4319
						2 4309
						3 4290
						4 4280
						5 4271
						6 4262
						7 4253
						8 4234
						9 4225
						10 4216
						11 4207
						12 4198
						13 4181
						14 4172
						15 4163
						16 4155
						17 4146
						18 4129
						19 4120
						20 4112
						21 4104
						22 4096
						23 4088
						24 4071
						25 4064
						26 4056
						27 4049
						28 4042
						29 4026
						30 4017
						31 4010
						32 4003
						33 3997
						34 3983
						35 3977
						36 3970
						37 3963
						38 3956
						39 3941
						40 3932
						41 3922
						42 3912
						43 3903
						44 3896
						45 3883
						46 3877
						47 3872
						48 3867
						49 3862
						50 3853
						51 3849
						52 3845
						53 3841
						54 3837
						55 3829
						56 3825
						57 3822
						58 3819
						59 3816
						60 3809
						61 3806
						62 3803
						63 3800
						64 3797
						65 3792
						66 3789
						67 3787
						68 3784
						69 3781
						70 3777
						71 3766
						72 3760
						73 3755
						74 3751
						75 3748
						76 3740
						77 3736
						78 3732
						79 3729
						80 3726
						81 3719
						82 3716
						83 3711
						84 3706
						85 3701
						86 3692
						87 3686
						88 3679
						89 3677
						90 3676
						91 3675
						92 3674
						93 3672
						94 3670
						95 3667
						96 3652
						97 3590
						98 3547
						99 3491
						100 3414
						100 3400>;

	r_profile_t0_num = <102>;
	r_profile_t0 = <469 4330
					469 4315
					470 4302
					468 4279
					463 4269
					459 4260
					460 4250
					460 4242
					456 4231
					452 4213
					449 4205
					449 4196
					448 4187
					447 4179
					447 4162
					445 4153
					441 4144
					440 4135
					440 4126
					439 4117
					437 4101
					437 4094
					441 4088
					446 4083
					450 4077
					451 4070
					447 4046
					436 4030
					428 4013
					422 3997
					413 3983
					412 3972
					404 3952
					401 3944
					399 3937
					400 3931
					396 3925
					398 3920
					397 3909
					396 3904
					395 3900
					395 3894
					396 3889
					396 3879
					395 3873
					396 3868
					396 3864
					396 3859
					398 3855
					398 3846
					399 3841
					402 3838
					404 3834
					404 3830
					406 3826
					410 3820
					413 3816
					416 3813
					417 3810
					419 3806
					422 3804
					429 3798
					432 3796
					436 3793
					438 3791
					440 3789
					442 3787
					444 3783
					448 3782
					450 3780
					453 3779
					455 3777
					462 3773
					463 3771
					469 3769
					473 3767
					476 3764
					476 3762
					405 3756
					491 3752
					496 3748
					500 3744
					507 3740
					512 3736
					522 3726
					529 3721
					505 3717
					543 3712
					554 3710
					569 3707
					603 3702
					623 3699
					650 3695
					678 3689
					708 3679
					735 3662
					785 3610
					819 3576
					864 3535
					923 3483
					1010 3418
					1010 3400>;

	r_profile_t1_num = <102>;
	r_profile_t1 = <211 4346
					211 4333
					213 4310
					214 4300
					215 4290
					215 4281
					216 4271
					218 4254
					220 4245
					216 4236
					216 4227
					217 4218
					218 4201
					222 4192
					222 4184
					221 4176
					224 4168
					223 4150
					226 4142
					227 4133
					230 4125
					230 4116
					232 4100
					233 4094
					235 4089
					237 4085
					244 4080
					252 4063
					248 4049
					244 4032
					239 4016
					239 4002
					234 3981
					233 3972
					235 3965
					234 3958
					232 3951
					227 3939
					223 3933
					221 3927
					216 3920
					215 3913
					209 3900
					207 3894
					205 3888
					204 3882
					202 3876
					204 3867
					203 3862
					203 3857
					203 3853
					204 3849
					206 3841
					206 3837
					206 3834
					209 3830
					206 3826
					208 3820
					210 3817
					212 3814
					213 3811
					215 3808
					216 3803
					217 3800
					219 3798
					218 3795
					222 3793
					223 3789
					223 3787
					225 3785
					226 3783
					227 3781
					227 3778
					225 3776
					223 3774
					206 3772
					227 3769
					228 3764
					229 3761
					230 3758
					232 3755
					233 3751
					235 3742
					237 3738
					238 3734
					242 3730
					243 3724
					240 3712
					243 3708
					247 3706
					250 3704
					254 3702
					268 3699
					278 3696
					290 3690
					300 3676
					309 3654
					325 3588
					344 3544
					363 3489
					393 3413
					393 3400>;

	r_profile_t2_num = <102>;
	r_profile_t2 = <120 4340
					120 4336
					119 4319
					120 4310
					119 4300
					119 4290
					118 4281
					118 4262
					119 4253
					119 4244
					120 4235
					120 4218
					120 4208
					120 4200
					120 4191
					120 4182
					120 4164
					121 4156
					120 4147
					121 4139
					122 4122
					122 4113
					122 4105
					123 4096
					121 4088
					116 4073
					117 4069
					124 4066
					129 4059
					143 4038
					143 4024
					120 4010
					133 4000
					129 3991
					125 3979
					125 3975
					128 3971
					130 3967
					136 3956
					138 3948
					138 3941
					137 3932
					135 3923
					123 3904
					118 3895
					113 3888
					112 3881
					108 3870
					108 3865
					106 3860
					107 3855
					104 3846
					104 3842
					105 3839
					104 3835
					103 3831
					102 3824
					102 3821
					104 3818
					105 3814
					103 3808
					105 3806
					105 3803
					106 3800
					106 3798
					105 3792
					105 3790
					106 3788
					106 3786
					107 3781
					106 3778
					107 3775
					106 3772
					105 3768
					105 3761
					105 3758
					104 3755
					105 3752
					102 3745
					104 3743
					104 3740
					105 3737
					107 3732
					108 3724
					106 3718
					106 3713
					108 3709
					111 3699
					103 3693
					99 3690
					99 3689
					101 3688
					108 3686
					113 3685
					123 3682
					143 3679
					194 3643
					216 3608
					248 3565
					297 3511
					391 3439
					391 3400>;

	r_profile_t3_num = <102>;
	r_profile_t3 = <144 4329
					85 4319
					86 4309
					87 4290
					87 4280
					88 4271
					88 4262
					88 4253
					88 4234
					88 4225
					88 4216
					88 4207
					88 4198
					89 4181
					89 4172
					88 4163
					90 4155
					90 4146
					89 4129
					88 4120
					89 4112
					91 4104
					91 4096
					91 4088
					91 4071
					91 4064
					92 4056
					92 4049
					95 4042
					94 4026
					94 4017
					94 4010
					95 4003
					96 3997
					97 3983
					98 3977
					99 3970
					100 3963
					100 3956
					102 3941
					102 3932
					99 3922
					96 3912
					92 3903
					92 3896
					89 3883
					90 3877
					89 3872
					89 3867
					89 3862
					89 3853
					89 3849
					89 3845
					89 3841
					89 3837
					88 3829
					89 3825
					90 3822
					91 3819
					90 3816
					90 3809
					89 3806
					91 3803
					91 3800
					92 3797
					92 3792
					93 3789
					94 3787
					94 3784
					95 3781
					93 3777
					90 3766
					89 3760
					89 3755
					89 3751
					91 3748
					90 3740
					90 3736
					89 3732
					90 3729
					90 3726
					90 3719
					91 3716
					91 3711
					91 3706
					90 3701
					91 3692
					92 3686
					89 3679
					88 3677
					89 3676
					90 3675
					94 3674
					97 3672
					104 3670
					114 3667
					106 3652
					104 3590
					109 3547
					109 3491
					114 3414
					114 3400>;
};
